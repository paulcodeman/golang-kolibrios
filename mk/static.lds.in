PHDRS
{
    text PT_LOAD FLAGS(5);
    data PT_LOAD FLAGS(6);
    stack PT_GNU_STACK FLAGS(6);
}

SECTIONS
{
    . = 0x00000;

    .text :
    {
        LONG(0x554E454D);
        LONG(0x31305445);
        LONG(1);
        LONG(@ENTRYPOINT@);
        LONG(__end);
        LONG(__memory_top);
        LONG(__memory_top);
        LONG(0);
        LONG(0);

        *(.text)
        *(.text.*)
    } :text

    .rodata :
    {
        *(.rodata)
        *(.rodata.*)
    } :text

    .data :
    {
        *(.data)
        *(.data.*)
    } :data

    .bss :
    {
        *(COMMON)
        *(.bss)
        *(.bss.*)
    } :data

    .eh_frame :
    {
        *(.eh_frame)
    } :text

    .group :
    {
        *(.group)
    } :text

    __end = .;
    __memory_top = ((__end + 0xFFF) & ~0xFFF) + @STACK_RESERVE@;

    .note.GNU-stack : { } :text :stack
}
